#include <Arduino.h>

#define RXD1 10 // some random pin
#define TXD1 21

#define RXD2 22
#define TXD2 20 // Some random pin

#define NODE_ID 4 // Drive 1

#define GET_CMD(b) (b >> 4)
#define GET_NODE_ID(b) (b & 0x0F)

#define COMMAND_CONTROL_RESET 0x00
#define COMMAND_CONTROL_STATUS 0x01
#define COMMAND_CONTROL_ACK 0x02
#define COMMAND_CONTROL_CTS 0x03
#define COMMAND_CONTROL_RECEIVE 0x04
#define COMMAND_CONTROL_CANCEL 0x05
#define COMMAND_DATA_SEND 0x06
#define COMMAND_CONTROL_NAK 0x07
#define COMMAND_CONTROL_READY 0x0D

#define RESPONSE_CONTROL_STATUS 0x08
#define RESPONSE_CONTROL_ACK 0x09
#define RESPONSE_CONTROL_CANCEL 0x0A
#define RESPONSE_DATA_SEND 0x0B
#define RESPONSE_CONTROL_NAK 0x0C

#define ACK(b) (0x80 | b)

byte status[6] = {0x84, 0x00, 0x04, 0x01, 0x40, 0x45};

byte testBlock[1028] =
    {
        0xB4, 0x04, 0x00, // Header

        0x78, 0x32, 0x6f, 0xfd, 0xcd, 0x16, 0xc8, 0x21, 0x76, 0xc8, 0x11, 0x89,
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        0x00, 0x00, 0x00, 0x00,

        0x04 // Checksum

};

void wait_for_idle()
{
  bool isIdle = false;
  unsigned long start, current;

  do
  {
    while (digitalRead(RXD2) == HIGH)
      yield();

    start = micros();

    while ((digitalRead(RXD2) == LOW) && (isIdle == false))
    {
      current = micros();
      if ((current - start) > 900)
        isIdle = true;
    }
  } while (isIdle == false);
}

byte adamnet_recv()
{
  byte incomingByte = 0;

  // Sample the start bit
  while (digitalRead(RXD2) == LOW)
    yield();
  ets_delay_us(16);

  // Sample the data bits
  for (unsigned char i = 8; i > 0; --i)
  {
    incomingByte >>= 1;
    if (digitalRead(RXD2) == LOW)
      incomingByte |= 0x80;
    else
      incomingByte |= 0x00;
    ets_delay_us(16);
  }

  // Sample the stop bit
  ets_delay_us(16);

  return incomingByte;
}

void adamnet_recv_bytes(byte *b, int len)
{
  for (int i = 0; i < len; i++)
    b[i] = adamnet_recv();
}

void adamnet_send(byte b)
{
  // Send start bit
  digitalWrite(TXD1, LOW);
  ets_delay_us(16);

  // Send data bits
  for (byte mask = 0x01; mask > 0; mask <<= 1)
  {
    if (b & mask)
      digitalWrite(TXD1, LOW);
    else
      digitalWrite(TXD1, HIGH);
    ets_delay_us(16);
  }

  // Send stop bit.
  digitalWrite(TXD1, HIGH);
  ets_delay_us(16);
}

void adamnet_send_bytes(byte *b, int len)
{
  for (int i = 0; i < len; i++)
    adamnet_send(b[i]);
}

void send_status()
{
  Serial.printf("Sending Status.\n");
  ets_delay_us(150);
  adamnet_send_bytes(status, sizeof(status));
  Serial.printf("ACK sent %02X\n", adamnet_recv());
  wait_for_idle();
}

void handle_ready()
{
  byte transferCommand[9];

  ets_delay_us(150);
  adamnet_send(0x94); // send our ack
  adamnet_recv_bytes(transferCommand, sizeof(transferCommand));
  if (GET_CMD(transferCommand[0]) == COMMAND_DATA_SEND)
  {
    byte b;

    Serial.printf("COMMAND.CONTROL.SEND\n");
    ets_delay_us(150);
    adamnet_send(0x94); // send our ack
    b = adamnet_recv();
    if (GET_CMD(b) == COMMAND_CONTROL_RECEIVE)
    {
      unsigned long blockno = transferCommand[6] << 24 | transferCommand[5] << 16 | transferCommand[4] << 8 | transferCommand[3];
      ets_delay_us(150);
      Serial.printf("Requested block #%lu", blockno);
      adamnet_send(0x94); // send our ack
      b = adamnet_recv();
      if (GET_CMD(b) == COMMAND_CONTROL_CTS)
      {
        adamnet_send_bytes(testBlock, sizeof(testBlock));
        b = adamnet_recv();
        if (GET_CMD(b) == COMMAND_CONTROL_ACK)
        {
          Serial.printf("All good.\n");
        }
      }
    }
  }
}

void setup()
{
  pinMode(2, OUTPUT);
  pinMode(4, OUTPUT);
  pinMode(13, OUTPUT);
  pinMode(TXD1, OUTPUT);
  pinMode(RXD2, INPUT);

  digitalWrite(TXD1, HIGH); // So the AdamNet doesn't contend.
  digitalWrite(2, 1);       // turn off LEDs
  digitalWrite(4, 1);
  digitalWrite(13, 1);

  Serial.begin(921600);

  Serial.printf("\n\n\n#FujiNet Test #7 - Status Round 2\n\n\n");
}

void loop()
{
  unsigned char b = adamnet_recv();
  unsigned char dev = GET_NODE_ID(b);
  unsigned char cmd = GET_CMD(b);

  if (dev == NODE_ID)
  {
    if (cmd == COMMAND_CONTROL_STATUS)
      send_status();
    else if (cmd == COMMAND_CONTROL_READY)
      handle_ready();
  }
  else
    wait_for_idle();
}