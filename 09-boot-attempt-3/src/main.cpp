#include <Arduino.h>

#define TXD2 21
#define RXD2 22

#define COMMAND_CONTROL_RESET 0x00
#define COMMAND_CONTROL_STATUS 0x01
#define COMMAND_CONTROL_ACK 0x02
#define COMMAND_CONTROL_CTS 0x03
#define COMMAND_CONTROL_RECEIVE 0x04
#define COMMAND_CONTROL_CANCEL 0x05
#define COMMAND_DATA_SEND 0x06
#define COMMAND_CONTROL_NAK 0x07
#define COMMAND_CONTROL_READY 0x0D

#define RESPONSE_CONTROL_STATUS 0x08
#define RESPONSE_CONTROL_ACK 0x09
#define RESPONSE_CONTROL_CANCEL 0x0A
#define RESPONSE_DATA_SEND 0x0B
#define RESPONSE_CONTROL_NAK 0x0C

byte status[6] =
    {
        0x84,       // response.control.status
        0x00, 0x04, // length, 4 bytes (big endian)
        0x01,       // Device mode = block mode
        0x40,       // Device dependent status byte
        0x45        // Checksum
};

byte testBlock[1028] =
    {
        0xB4,       // response.data.send
        0x04, 0x00, // Length, 1024 bytes (big endian)

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        0x00, 0x00, 0x00, 0x00,

        0x04 // Checksum

};

/**
 * @brief wait for bus idle state
 * This works by waiting for a transition to LOW,
 * and subsequently sampling bit cells
 * until we see 10 contiguous LOW signals
 * indicating that the bus is now idle.
 */
void wait_for_idle()
{
  byte cellCount = 0;

  while (digitalRead(RXD2) == HIGH)
    yield();

  while (cellCount < 10)
  {
    if (digitalRead(RXD2) == LOW)
      cellCount++;
    else
      cellCount = 0;

    ets_delay_us(16); // Delay to next bit cell.
  }
}

byte adamnet_recv()
{
  byte incomingByte = 0;

  // Sample the start bit
  while (digitalRead(RXD2) == LOW)
    yield();
  ets_delay_us(16);

  // Sample the data bits
  for (unsigned char i = 8; i > 0; --i)
  {
    incomingByte >>= 1;
    if (digitalRead(RXD2) == LOW)
      incomingByte |= 0x80;
    else
      incomingByte |= 0x00;
    ets_delay_us(16);
  }

  // Sample the stop bit
  ets_delay_us(16);

  return incomingByte;
}

void adamnet_recv_bytes(byte *b, int len)
{
  for (int i = 0; i < len; i++)
    b[i] = adamnet_recv();
}

void adamnet_send(byte b)
{
  // Send start bit
  digitalWrite(TXD2, LOW);
  ets_delay_us(16);

  // Send data bits
  for (byte mask = 0x01; mask > 0; mask <<= 1)
  {
    if (b & mask)
      digitalWrite(TXD2, LOW);
    else
      digitalWrite(TXD2, HIGH);
    ets_delay_us(16);
  }

  // Send stop bit.
  digitalWrite(TXD2, HIGH);
  ets_delay_us(16);
}

void adamnet_send_bytes(byte *b, int len)
{
  for (int i = 0; i < len; i++)
    adamnet_send(b[i]);
}

void command_control_reset()
{
  // Let's not do anything for now.
}

void command_control_status()
{
  Serial.printf("command.control.status() ");
  ets_delay_us(150);
  adamnet_send_bytes(status,sizeof(status));
}

void command_control_ack()
{
  Serial.printf("command.control.ack()\n");
}

void command_control_cts()
{
  Serial.printf("command.control.clr() - Sending test block!  ");
  adamnet_send_bytes(testBlock,sizeof(testBlock));
}

void command_control_receive()
{
  Serial.printf("command.control.receive()");
  ets_delay_us(150);
  adamnet_send(0x94); // RESPONSE.CONTROL.ACK for DEVICE 4, Tell Adam the block is ready.
}

void command_control_cancel()
{
  Serial.printf("command.control.cancel() - ADAM asked us to cancel\n");
  ets_delay_us(150);
  adamnet_send(0x94); // I'm assuming we should send back an ack. TODO: Will check the master 6801.
}

void command_data_send()
{
  byte transferData[9];
  unsigned long requestedBlock=0;
  Serial.printf("command.data.send() - Getting transfer data - ");
  ets_delay_us(150);
  adamnet_send(0x94); // Send ack to ADAM, letting it know we got the send command.
  adamnet_recv_bytes(transferData,sizeof(transferData)); // Get requested block payload
  requestedBlock = (transferData[6] << 24) | (transferData[5] << 16) | (transferData[4] << 8) | transferData[3];
  Serial.printf("Requested block: %lu", requestedBlock);
}

void command_control_nak()
{
  Serial.printf("command.control.nak()\n");
}

void command_control_ready()
{
  ets_delay_us(150); // Wait so adam doesn't miss
  adamnet_send(0x94); // Ack.
}

void setup()
{
  Serial.begin(921600);

  pinMode(RXD2, INPUT);
  pinMode(TXD2, OUTPUT);
  pinMode(2, OUTPUT);
  pinMode(4, OUTPUT);
  pinMode(13, OUTPUT);
  digitalWrite(TXD2, HIGH); // So the AdamNet doesn't contend.
  digitalWrite(2, HIGH);
  digitalWrite(4, HIGH);
  digitalWrite(13, HIGH);

  Serial.printf("\n\n#FujiNet AdamNet test #9 - boot attempt #3.\n\n");
}

void loop()
{
  byte b = adamnet_recv();
  byte d = b & 0x0F;
  byte c = b >> 4;

  if (d == 4)
  {
    switch (c)
    {
    case COMMAND_CONTROL_RESET:
      command_control_reset();
      wait_for_idle();
    case COMMAND_CONTROL_STATUS:
      command_control_status();
      wait_for_idle();
      break;
    case COMMAND_CONTROL_ACK:
      command_control_ack();
      wait_for_idle();
      break;
    case COMMAND_CONTROL_CTS:
      command_control_cts();
      wait_for_idle();
      break;
    case COMMAND_CONTROL_RECEIVE:
      command_control_receive();
      wait_for_idle();
      break;
    case COMMAND_CONTROL_CANCEL:
      command_control_cancel();
      wait_for_idle();
      break;
    case COMMAND_DATA_SEND:
      command_data_send();
      wait_for_idle();
      break;
    case COMMAND_CONTROL_NAK:
      command_control_nak();
      wait_for_idle();
      break;
    case COMMAND_CONTROL_READY:
      command_control_ready();
      wait_for_idle();
      break;
    default:
      Serial.printf("Unhandled Command: %02X\n",c);
      break;
    }
  }
}